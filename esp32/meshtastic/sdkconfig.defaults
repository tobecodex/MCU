## esp32/meshtastic/sdkconfig.defaults
```kconfig
#
# ESP-IDF Configuration for Heltec V3
#
CONFIG_IDF_TARGET="esp32"
CONFIG_PARTITION_TABLE_SINGLE_APP=y

#
# Serial flasher config
#
CONFIG_ESPTOOLPY_BAUD_921600B=y

#
# Power Management
#
CONFIG_PM_ENABLE=y
CONFIG_FREERTOS_USE_TICKLESS_IDLE=y

#
# WiFi Configuration (required by ESP-IDF but not used)
#
CONFIG_ESP_WIFI_STATIC_RX_BUFFER_NUM=16
CONFIG_ESP_WIFI_DYNAMIC_RX_BUFFER_NUM=32
CONFIG_ESP_WIFI_RX_BA_WIN=16
```
